## main/Kconfig.projbuild
```kconfig
menu "XiaoZhi Assistant App"

    config XZ_WIFI_SSID
        string "Wi-Fi SSID (2.4GHz only)"
        default "myssid"
        help
            开发板通过板载 ESP32-C6 连接 2.4GHz Wi-Fi。
            注意：ESP32-C6 不支持 5GHz。

    config XZ_WIFI_PASSWORD
        string "Wi-Fi Password"
        default "mypassword"

    config XZ_SPEAKER_VOLUME
        int "Speaker volume (0-100, initial; runtime adjustable)"
        range 0 100
        default 85

    config XZ_MIC_GAIN_DB
        int "Microphone gain (dB, ES7210)"
        range 0 42
        default 18
        help
            麦克风增益。识别不灵敏时可调大（如 24/30），
            背景噪声大或识别含糊时可调小（如 6/12）。

    config XZ_WAKEWORD_ENABLE
        bool "Enable offline wake word (小特小特 / ESP-SR WakeNet)"
        default y
        select SR_WN_WN9_XIAOTEXIAOTE_TTS2
        help
            免按键唤醒：说出唤醒词「小特小特」即开始对话（离线识别，不需要联网）。
            唤醒后自动开始聆听，停顿后自动结束并发送（VAD 断句），
            触摸按钮仍然可用（点按可提前结束/打断）。
            需要分区表中包含 model 分区（本项目 partitions.csv 已包含）。

    config XZ_WAKEWORD_AUTO_STOP_MS
        int "Auto-stop after silence (ms)"
        depends on XZ_WAKEWORD_ENABLE
        range 400 3000
        default 1000
        help
            唤醒模式下的自动断句时间：检测到说话后，静音超过该时长即自动结束录音并发送。

endmenu
```
